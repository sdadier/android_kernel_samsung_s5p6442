## arch/arm/mach-s5p6442/Kconfig
```kconfig
# arch/arm/mach-s5p6442/Kconfig
#
# Copyright (c) 2010 Samsung Electronics Co., Ltd.
#		http://www.samsung.com/
#
# Licensed under GPLv2

# Configuration options for the S5P6442

if ARCH_S5P6442

config CPU_S5P6442
	bool
	select S3C_PL330_DMA
	select S5P_PM
	select S5P_HRT
	help
	  Enable S5P6442 CPU support

config MACH_SMDK6442
	bool "SMDK6442"
	select CPU_S5P6442
	select S3C_DEV_WDT
	help
	  Machine support for Samsung SMDK6442
	  
config MACH_APOLLO
	bool "APOLLO"
	select CPU_S5P6442
	select S3C_DEV_FB
#	select S3C_DEV_I2C1
	select S3C_DEV_RTC
	select S3C_DEV_WDT
	select S3C_DEV_HSMMC
	select S3C_DEV_HSMMC1
	select S3C_DEV_HSMMC2
	select SAMSUNG_DEV_ADC
	select SAMSUNG_DEV_BACKLIGHT
	select SAMSUNG_DEV_PWM
	select SAMSUNG_DEV_TS
	help
	  Machine support for the Samsung Galaxy Apollo

endif
```
